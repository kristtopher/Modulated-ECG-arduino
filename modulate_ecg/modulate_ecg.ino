int8_t myEcg[] = {-2, -3, -2, -2, -2, 0, -1, -2, 0, 0, 1, 2, 0,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 -1, -2};

int pin_data  = 13;              // saída do PWM (eletrodo)
int pin_OnOff = 12;
int delayTime = 10;//300;
const long interval = 125; // interval at which to stop PWM (milliseconds)
unsigned long previousMillis = 0;
String control = "00";

void setup() {
  Serial.begin(9600);
  pinMode      (pin_data, OUTPUT); // pin 13
  pinMode      (pin_OnOff,OUTPUT);
  digitalWrite (pin_data, LOW );
  digitalWrite (pin_OnOff,HIGH);
}

void loop() {
  String data, packet;
  boolean shouldSend;
  uint32_t skey[4] = {0x9474B8E8, 0xC73BCA7D, 0x53239142, 0xF3C3121A};
  for(int i = 0; i < sizeof(myEcg); i++){         
    data = String(myEcg[i], BIN); // pacote de dados
    if(data.length() <= 8)
      packet += complete_zeros(8 - data.length()) + data;
    else if(data.length() > 8){
      for(int j = 8; j < data.length(); j++){
        packet += data[j];
      }
    }
    if (data != "") { // montagem do pacote   
      shouldSend = true;
       Serial.println(packet);
    }
    
    if (shouldSend) {
      shouldSend = false;
      //unsigned long currentMillis = millis();
      modulation(packet);                // envio do pacote 8bits em 1050ms
      //Serial.print("Time: ");
      //Serial.println(millis() - currentMillis);
      delay(delayTime);
    }
    // Reset variables
    packet = data = ""; 
  }
  delay(delayTime*1000);
}

void OOK_2mod(int state) {
  unsigned long currentMillis = micros();
  while (currentMillis + interval > micros())  //"espera ocupada"
    digitalWrite(pin_data,state);
}

void modulation(String packet){
  digitalWrite (pin_OnOff,LOW);
  //OOK_2mod(0);//startbit
  for (int i = 0; i < packet.length(); i++) {
    //Serial.print(packet.charAt(i));
    if (packet.charAt(i) == '0'){
      OOK_2mod(0);
    }
    else if (packet.charAt(i) == '1')
      OOK_2mod(1);
  }
  digitalWrite (pin_OnOff,HIGH);
  //Serial.println();
}

String complete_zeros(int len){
  String zeros;
  for (int i = 0; i < len; i++)
    zeros = zeros + "0";
  return zeros;
}
